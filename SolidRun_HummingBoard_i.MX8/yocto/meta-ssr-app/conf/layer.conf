## SolidRun_HummingBoard_i.MX8/yocto/meta-ssr-app/conf/layer.conf
```bitbake
BBPATH .= ":${LAYERDIR}"
BBFILES += "${LAYERDIR}/recipes-*/*/*.bb \
            ${LAYERDIR}/recipes-*/*/*.bbappend"

BBFILE_COLLECTIONS += "meta-company"
BBFILE_PATTERN_meta-company = "^${LAYERDIR}/"
BBFILE_PRIORITY_meta-company = "6"

LAYERDEPENDS_meta-company = "core"
LAYERSERIES_COMPAT_meta-company = "kirkstone"
```
